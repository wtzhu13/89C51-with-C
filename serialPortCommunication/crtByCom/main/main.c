/*******************************************************************************
 * All rights reserved, Copyright (C) wtzhu                                             
 * -----------------------------------------------------------------------------
 * [File Name]: 			main.c
 * [Description]: 			验证串口中断
 *               1、数码管初始显示0
 *               2、通过串口发送‘a’字符，数码管开始计时，每秒加一，并向上位机发送当前值
 *               3、通过串口发送‘b’字符，数码管停止计时
 *               4、通过串口发送‘c’字符，数码管清零
 *				
 * [Author]: 				wtzhu
 * [e-mail]:                wtzhu_13@163.com	
 * [Date Of Creation]: 		20200314
 * [Note]: 
 *
 * ------------------------------------------------------------------------------
 * Date					Author				Modifications
 * ------------------------------------------------------------------------------
 * 20200314				wtzhu			    Created
 *******************************************************************************/

#include <reg52.h>
#include <intrins.h>
#include <stdio.h>
#include "../delay/timeDebug.h"
#include "../nixieTube/show.h"

#define uint unsigned int
#define uchar unsigned char

/***********************************************************/
/*********************全局变量区*****************************/
/***********************************************************/

unsigned char flag_uart, i, a, flag_on, flag_time, time_count;
// uchar code table[] = "I have ";
uint showNum = 0;

/***********************************************************/
/*********************中断初始化程序*************************/
/***********************************************************/

void interruptInit()
{
    TMOD = 0x21;    
    TH1 = 0xfd;     // 9600波特率对应的初始值
    TL1 = 0xfd;
    //ET1 = 1;      // 用作波特率发生器是，不能启动，不然程序不停进中断，程序会跑飞掉      
    TR1 = 1; 
    TH0 = (65536 - 50000)/256;      // 设置定时器初始值
    TL0 = (65536 - 50000)%256; 
    ET0 = 1;                        // 开定时器0中断
    SM0 = 0;       
    SM1 = 1;
    REN = 1;        // 先设置串口模式，在打开接受，不然会议方式0接受数据
    EA = 1;         
    ES = 1;       
}

/***********************************************************/
/*********************串口信息判断程序***********************/
/***********************************************************/

void chooseAction()
{
    flag_uart = 0;
    ES = 0;    // 关闭串口中断，避免发送结束位TI=1时进入中断程序
    TI = 1;    // 由于putchar函数中的设定，所以使用puts和printf时需要手动将TI设置为1
    switch (a)
    {
    case 'a':
        TR0 = 1;
        printf("Turn on\n");
        break;

    case 'b':
        TR0 = 0;
        printf("Turn off\n");
        break;

    case 'c':
        TR0 = 0;
        showNum = 0;
        TH0 = (65536 - 50000)/256;      // 重新设置定时器初始值
        TL0 = (65536 - 50000)%256; 
        printf("clear\n");
        break;
    
    default:
        printf("err\n");
        break;
    }  
    while(!TI);
    TI = 0; 
    ES = 1;     // 打开串口中断，等待接受串口数据
}

/***********************************************************/
/*********************启动定时器程序*************************/
/***********************************************************/

void timeOn()
{
    flag_time = 0;
    showNum ++;
    ES = 0;
    TI = 1;
    printf("showNum:%d\n", showNum);
    while(!TI);
    TI = 0;
    ES = 1;
}

/***********************************************************/
/*********************主程序入口*****************************/
/***********************************************************/

void main()
{
    interruptInit();
    while (1)
    {
        show2Bit(showNum);
        if (flag_uart == 1)
        {
            chooseAction();        
        } 
        if (flag_time == 1)
        {
             timeOn();
        }
              
    }
}

/***********************************************************/
/*********************定时器0中断程序************************/
/***********************************************************/


void timer0() interrupt 1
{
    TH0 = (65536 - 50000)/256;
    TL0 = (65536 - 50000)%256;
    time_count ++;
    if (time_count == 20)
    {
        time_count = 0;
        flag_time = 1;
    }
    
}

/***********************************************************/
/**********************串口中断程序**************************/
/***********************************************************/

void ser() interrupt 4
{
    RI = 0;     // 手动置为0
    a = SBUF;   // 读取寄存器值
    flag_uart = 1;
}




