/*******************************************************************************
 * All rights reserved, Copyright (C) wtzhu                                             
 * -----------------------------------------------------------------------------
 * [File Name]: 			main.c
 * [Description]: 			验证串口中断
 *				
 * [Author]: 				wtzhu	
 * [Date Of Creation]: 		20200314
 * [Note]: 
 *
 * ------------------------------------------------------------------------------
 * Date					Author				Modifications
 * ------------------------------------------------------------------------------
 * 20200314				wtzhu			Created
 *******************************************************************************/
#include <reg52.h>

#define uint unsigned int
#define uchar unsigned char

uchar i, a, flag_uart;
uint timeFlag = 0, timeCount = 0; 
uchar code table[] = "I get ";

/***********************************************************/
/*********************中断初始化****************************/
/***********************************************************/
void init()
{
    TMOD = 0x21;
    TH1 = 0xfd;
    TL1 = 0xfd;
    TR1 = 1;
    TH0 = (65536 - 5000)/256;
    TL0 = (65536 - 5000)%256;
    ET0 = 1;   
    SM0 = 0;
    SM1 = 1;
    REN = 1;
    EA = 1;
    ES = 1;
}

/***********************************************************/
/*********************主函数入口****************************/
/***********************************************************/

void main()
{
    init();
    while (1)
    {
        if (flag_uart == 1)
        {
            ES = 0;
            for ( i = 0; i < 6; i++)
            {
                SBUF = table[i];
                while(!TI);
                TI = 0;
            }
            SBUF = a;
            while(!TI);
            TI = 0;
            ES = 1;
            flag_uart = 0;
        }
        
    }
    
}

/***********************************************************/
/*********************T0***中断程序*************************/
/***********************************************************/

void timer() interrupt 1
{
    TH0 = (65536 - 5000)/256;
    TL0 = (65536 - 5000)%256;
    timeCount ++;
    if (timeCount == 20)
    {
        timeFlag = 1;
    }
    
}

/***********************************************************/
/*********************串口中断程序***************************/
/***********************************************************/

void ser() interrupt 4
{
    RI = 0;
    a = SBUF;
    flag_uart = 1;
}

